#include "envelope_controls.h"
#include "note_bank.h"
#include "note_envelope.h"
#include "note_filter.h"
#include "stream_ring.h"

#include <array>
#include <cmath>
#include <fstream>
#include <iostream>
#include <iterator>
#include <stdexcept>
#include <vector>

namespace {
void require(bool condition, char const* message)
{
    if (!condition) throw std::runtime_error(message);
}
template<class F> void rejected(F operation)
{
    bool failed = false;
    try { operation(); } catch (std::exception const&) { failed = true; }
    require(failed, "Invalid operation accepted");
}
void near(float actual, double expected, double tolerance = 0.00002)
{
    if (std::abs(actual - expected) > tolerance)
        throw std::runtime_error("Amplitude " + std::to_string(actual) +
                                 " differs from expected " + std::to_string(expected));
}

std::array<int8_t, 1024> pcm;
void supply()
{
    for (unsigned v = 0; v < NOTE_BANK_VOICES; ++v) {
        auto session = StreamRing_CurrentSession(v);
        if (session != 255 && StreamRing_CurrentFree(v) >= pcm.size())
            require(StreamRing_WriteBody(v, session, pcm.data(), pcm.size()) == 1, "Current BODY rejected");
        if (StreamRing_HasPending(v) && StreamRing_FreeLevel(v) >= pcm.size())
            require(StreamRing_WriteBody(v, StreamRing_TargetSession(v), pcm.data(), pcm.size()) == 1,
                    "Pending BODY rejected");
    }
}
int32_t render(unsigned milliseconds)
{
    int32_t sample = 0;
    while (milliseconds--) {
        supply();
        NoteBank_VmBoundaryBegin();
        for (unsigned i = 0; i < 48; ++i) sample = NoteBank_NextSample();
        NoteBank_VmBoundaryEnd();
    }
    require(NoteBank_HoldCount() == 0, "BODY underrun");
    for (unsigned v = 0; v < NOTE_BANK_VOICES; ++v)
        require(NoteBank_VmFaultCount(v) == 0, "VM fault");
    return sample;
}

void load(envelope_controls::settings const& settings,
          std::filesystem::path const& compiler, std::filesystem::path const& directory)
{
    auto const source = directory / "envelope test.be";
    auto const bec = directory / "envelope test.bec";
    std::ofstream out(source);
    out << envelope_controls::program(settings);
    out.close();
    require(bool(out), "Cannot write test source");
    envelope_controls::compile(compiler, source, bec);
    std::ifstream input(bec, std::ios::binary);
    require(bool(input), "Cannot open compiled program");
    std::vector<char> program{std::istreambuf_iterator<char>(input), {}};
    StreamRing_Init();
    StreamRing_StatsClear();
    AttackBank_Init();
    NoteFilter_InitAll();
    NoteEnv_Init();
    NoteBank_Init();
    pcm.fill(64);
    require(AttackBank_Load(0, reinterpret_cast<uint8_t*>(pcm.data()), 512) == 0, "Attack load failed");
    for (unsigned v = 0; v < NOTE_BANK_VOICES; ++v) {
        require(NoteBank_VmUploadBegin(v) == 0, "Upload begin failed");
        require(NoteBank_VmUploadFeed(v, program.data(), program.size()) == 0, "Upload feed failed");
        require(NoteBank_VmUploadCommit(v) == 0, "Upload commit failed");
    }
}
void on(uint8_t velocity = 127, uint8_t session = 1)
{
    require(NoteBank_NoteOnSampleSession(0, 0, 60, velocity, session) == 0, "Note-on failed");
}
void off()
{
    require(NoteBank_NoteOff(0) == 0, "Note-off failed");
}
} // namespace

extern "C" int ChannelLed_Set(float, float, float, float) { return 0; }

int main(int argc, char** argv) try
{
    require(argc == 3, "Expected compiler and fixture directory");
    std::filesystem::path const compiler(argv[1]), directory(argv[2]);
    std::filesystem::create_directories(directory);
    using namespace envelope_controls;
    settings defaults;
    require(parse(":a 5", defaults).value.attack_ms == 5, "Attack is not milliseconds");
    require(parse(":r 250.5", defaults).value.release_ms == 250.5, "Fractional release rejected");
    require(parse(":s 0.007874", defaults).value.sustain == 0.007874, "Sustain rounded");
    require(parse(":g 0.01", defaults).value.gain == 0.01, "Gain rounded");
    require(!parse(":e off", defaults).value.enabled, "Bypass rejected");
    require(parse(":status", defaults).kind == action::status, "Status command rejected");
    require(parse(":help", defaults).kind == action::help, "Help command rejected");
    for (auto line : {":a -1", ":r -1", ":s 1.01", ":g -0.1", ":g nan", ":a inf",
                      ":a 1e400", ":g 1e-50", ":s 1 extra", ":a 5ms", ":e maybe",
                      ":a", ":unknown 1", ":help extra", ":a 5;touch"})
        rejected([&] { (void)parse(line, defaults); });
    require(defaults.attack_ms == 5000 && defaults.sustain == 1 && defaults.gain == 1,
            "Parsing changed applied settings");

    // Five-second attack at low gain, including soft MIDI velocity. Exercise
    // the generated bytecode and the actual VM, envelope, mixer and stream ring.
    auto value = parse(":g 0.01", defaults).value;
    load(value, compiler, directory);
    on(1);
    require(render(1) > 0, "Low-gain attack was rounded to silence");
    render(49);
    near(NoteEnv_Amplitude(0), 0.0001, 0.000001);
    render(2450);
    near(NoteEnv_Amplitude(0), 0.005);
    render(2510);
    near(NoteEnv_Amplitude(0), 0.01, 0.0000001);
    off(); render(6);
    require(!NoteBank_IsActive(0), "Default release did not finish");
    on(127, 2); render(50);
    near(NoteEnv_Amplitude(0), 0.0001, 0.000001);

    // Short attack, sustain * gain, and a timed release interrupted mid-attack.
    value = parse(":a 5", defaults).value;
    value = parse(":s 0.4", value).value;
    value = parse(":g 0.2", value).value;
    value = parse(":r 250", value).value;
    load(value, compiler, directory);
    on(); render(1); near(NoteEnv_Amplitude(0), 0.016);
    render(4); near(NoteEnv_Amplitude(0), 0.08);
    render(20); near(NoteEnv_Amplitude(0), 0.08);
    off(); render(125); near(NoteEnv_Amplitude(0), 0.04);
    render(126); require(!NoteBank_IsActive(0), "Timed release did not finish");
    value.attack_ms = 1000;
    load(value, compiler, directory);
    on(); render(250); near(NoteEnv_Amplitude(0), 0.02);
    off(); render(125); near(NoteEnv_Amplitude(0), 0.01);
    render(126); require(!NoteBank_IsActive(0), "Interrupted attack release did not finish");

    // Bypass ignores sustain and timings but retains the selected linear gain.
    value = parse(":e off", value).value;
    value.gain = 0.01;
    value.sustain = 0;
    value.release_ms = 5000;
    load(value, compiler, directory);
    on(1); require(render(1) > 0, "Bypass gain was silent");
    near(NoteEnv_Amplitude(0), 0.01, 0.0000001);
    render(50); near(NoteEnv_Amplitude(0), 0.01, 0.0000001);
    on(127, 2); render(10);
    require(StreamRing_CurrentSession(0) == 2, "Replacement did not activate");
    near(NoteEnv_Amplitude(0), 0.01, 0.0000001);
    off(); render(1); require(!NoteBank_IsActive(0), "Bypass note-off was not immediate");

    // Envelope-on replacement, release during the steal, zero duration/level,
    // and scientific-notation levels all need valid lifecycle behavior.
    value = defaults;
    value.attack_ms = 5;
    load(value, compiler, directory);
    on(); render(10); on(127, 2); render(12);
    near(NoteEnv_Amplitude(0), 1.0);
    require(StreamRing_CurrentSession(0) == 2, "Envelope replacement did not activate");
    on(127, 3); render(1); off(); render(10);
    require(!NoteBank_IsActive(0) && !StreamRing_HasPending(0), "Release revived a pending note");
    value.attack_ms = 0; value.release_ms = 0;
    load(value, compiler, directory);
    on(); render(1); near(NoteEnv_Amplitude(0), 1.0);
    off(); render(1); require(!NoteBank_IsActive(0), "Zero release did not stop");
    value.sustain = 0;
    load(value, compiler, directory);
    on(); require(render(10) == 0, "Zero sustain leaked audio");
    off(); render(1); require(!NoteBank_IsActive(0), "Silent note was not retired");
    value.enabled = false; value.gain = 0;
    load(value, compiler, directory);
    on(); require(render(10) == 0, "Zero gain leaked audio");
    off(); render(1); require(!NoteBank_IsActive(0), "Zero gain note was not retired");
    value.gain = 0.000001;
    load(value, compiler, directory);
    on(); require(render(1) > 0, "Small gain was lost in generated source");
    near(NoteEnv_Amplitude(0), value.gain, 0.000000001);

    rejected([&] { compile(directory / "missing compiler", directory / "envelope test.be",
                           directory / "failed.bec"); });
    auto const broken = directory / "invalid.be";
    { std::ofstream out(broken); out << "not a valid channel program\n"; }
    rejected([&] { compile(compiler, broken, directory / "failed.bec"); });
    std::cout << "PASS: command validation, compiled 5 s/5 ms attacks, velocity independence, "
                 "sustain/gain precision, release from current amplitude, bypass, replacements, "
                 "zero settings and compiler failures\n";
    return 0;
} catch (std::exception const& error) {
    std::cerr << error.what() << '\n';
    return 1;
}
